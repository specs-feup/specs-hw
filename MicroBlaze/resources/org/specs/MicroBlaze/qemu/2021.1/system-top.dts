/*
 * CAUTION: This file is automatically generated by Xilinx.
 * Version: XSCT 2021.1
 * Today is: Thu Aug  5 20:27:11 2021
 */


/dts-v1/;
/include/ "pl.dtsi"
/ {
	chosen {
		bootargs = "earlycon";
		stdout-path = "serial0:115200n8";
	};
	aliases {
		i2c0 = &axi_iic_0;
		serial0 = &axi_uartlite_0;
		spi0 = &axi_quad_spi_0;
	};
};
